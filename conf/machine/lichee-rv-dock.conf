## conf/machine/lichee-rv-dock.conf
```bitbake
#@TYPE: Machine
#@NAME: nezha-allwinner-d1
#@SOC: Allwinner D1
#@DESCRIPTION: Machine configuration for Nezha Allwinner-d1 board

require include/nezha-common.inc

#============================================
# Uboot Configuration
UBOOT_MACHINE = "lichee_rv_dock_defconfig"
UBOOT_DTB_BINARY ?= "sun20i-d1-lichee-rv-dock.dtb"
#============================================

#============================================
# Kernel Configuration
MACHINE_EXTRA_RRECOMMENDS += " kernel-module-rtl8723ds"
KERNEL_MODULE_AUTOLOAD:append = " hci_uart 8723ds "
#============================================

#============================================
# Machine Configuration
MACHINE_FEATURES:append = " wifi bluetooth"
#============================================

IMAGE_BOOT_FILES = " \
    ${KERNEL_IMAGETYPE} \
    boot.scr.uimg \
    uEnv.txt \
"
WKS_FILE = "lichee-rv-dock.wks"
```
